#ifndef TEMPERATURE_H
#define TEMPERATURE_H

#define temp_test_num 8

const short temptable[]=
{
	318,	//0
	315,	//1
	311,	//2
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	7,	//511
};

unsigned int bottom_val,nozzle_val;

int Lcd_bottomtemp()
{
	unsigned int temp=0;	
	for(int a=0;a<temp_test_num;a++){
		  temp += temptable[analogRead(bottom_pin)/2];
	}
 
	bottom_val = temp/temp_test_num;  
	return bottom_val;
}
int Lcd_nozzletemp(){

	unsigned int temp=0;	
	for(int a=0;a<temp_test_num;a++){
		  temp += temptable[analogRead(nozzle_pin)/2];
	}
 
	nozzle_val = temp/temp_test_num;	
	return nozzle_val;
}

void Heat_bottomtemp(){

	if(bottom_val > bottom_temp_max )
		digitalWrite(HeatGround,LOW);
	else if(bottom_val < bottom_temp_min )
		digitalWrite(HeatGround,HIGH);
}

void Heat_nozzletemp(){

	if(nozzle_val > nozzle_temp_max)
		digitalWrite(HeatHead,LOW);
	else if( nozzle_val < nozzle_temp_min )
		digitalWrite(HeatHead,HIGH);
}

#endif


